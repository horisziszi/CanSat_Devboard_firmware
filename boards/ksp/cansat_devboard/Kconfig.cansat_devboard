## boards/ksp/cansat_devboard/board.yml
```yaml
board:
  name: cansat_devboard
  full_name: cansat_devboard
  vendor: ksp
  socs:
    - name: nrf52840
```

## boards/ksp/cansat_devboard/cansat_devboard_defconfig
```kconfig
CONFIG_ARM_MPU=y
CONFIG_HW_STACK_PROTECTION=y
CONFIG_GPIO=y
CONFIG_SPI=y
CONFIG_I2C=y
CONFIG_SENSOR=y

# SX126X LoRa radio driver
CONFIG_LORA=y
CONFIG_LORA_SX126X=y

# SD card driver
CONFIG_DISK_ACCESS=y
CONFIG_DISK_DRIVER_SDMMC=y
CONFIG_SDMMC_SUBSYS=y

# NPM13XX PMIC driver
CONFIG_MFD=y
CONFIG_MFD_NPM13XX=y
CONFIG_REGULATOR=y
CONFIG_REGULATOR_NPM13XX=y
CONFIG_NPM13XX_CHARGER=y


# Configuring clock source
CONFIG_CLOCK_CONTROL_NRF_K32SRC_XTAL=y


# generate for adafruit uf2 bootloader flashing
CONFIG_BUILD_OUTPUT_UF2=y
CONFIG_FLASH_LOAD_OFFSET=0x1000
```
